## conf/distro/include/thunder_debug.conf
```bitbake
# FIXME: debug type has to be passed/selected based on the thunder build type requirement"
WPE_THUNDER_BUILDTYPE = "thunder_debugoptimized"
```

## conf/distro/include/thunder_generic.conf
```bitbake
# Enable compositor flag to enable thunder compositor as the backend
DISTRO_FEATURES_append = " compositor"
# Enable thunder flag to enable thunder specific events
DISTRO_FEATURES_append = " thunder"
WPE_THUNDER_BUILDTYPE = "thunder_release"
DISTRO_FEATURES_append = " ${WPE_THUNDER_BUILDTYPE}"
DISTROOVERRIDES .= ":${DISTRO_CODENAME}"

PREFERRED_VERSION_wpewebkit = "2.28%"
PREFERRED_VERSION_libwpe = "1.6.0%"
PREFERRED_VERSION_wpebackend-rdk = "git%"
PREFERRED_VERSION_icu = "65.%"
PREFERRED_PROVIDER_virtual/wpebackend = "wpebackend-rdk"

# Select packages based on distro name selection
require thunder_generic_dunfell.conf
require thunder_generic_morty.conf
require thunder_generic_krogoth.conf
```

## conf/distro/include/thunder_generic_dunfell.conf
```bitbake
PREFERRED_VERSION_cmake_dunfell = "3.16.%"
PREFERRED_VERSION_cmake-native_dunfell = "3.16.%"
PREFERRED_VERSION_gstreamer1.0_dunfell = "1.16.%"
PREFERRED_VERSION_gstreamer1.0-libav_dunfell = "1.16.%"
PREFERRED_VERSION_gstreamer1.0-plugins-bad_dunfell = "1.16.%"
PREFERRED_VERSION_gstreamer1.0-plugins-base_dunfell = "1.16.%"
PREFERRED_VERSION_gstreamer1.0-plugins-good_dunfell = "1.16.%"
PREFERRED_VERSION_gstreamer1.0-plugins-ugly_dunfell = "1.16.%"
PREFERRED_VERSION_libepoxy_dunfell = "1.5.4"
PREFERRED_VERSION_libsoup_dunfell = "2.4_2.68.4"

BBMASK:append_dunfell = " meta-wpe/recipes-core/glibc/glibc-locale_2.24.bbappend"
BBMASK:append_dunfell = " meta-wpe/recipes-support/libsoup/libsoup-2.4_2.58.1.bbappend"
BBMASK:append_dunfell = " meta-wpe-restricted/recipes-connectivity/openssl/openssl10_1.0.%.bbappend"
```

## conf/distro/include/thunder_generic_krogoth.conf
```bitbake
PREFERRED_VERSION_cmake_krogoth = "3.7.%"
PREFERRED_VERSION_cmake-native_krogoth = "3.7.%"
PREFERRED_VERSION_gstreamer1.0_krogoth = "1.10.4"
PREFERRED_VERSION_gstreamer1.0-libav_krogoth = "1.10.4"
PREFERRED_VERSION_gstreamer1.0-plugins-bad_krogoth = "1.10.4"
PREFERRED_VERSION_gstreamer1.0-plugins-base_krogoth = "1.10.4"
PREFERRED_VERSION_gstreamer1.0-plugins-good_krogoth = "1.10.4"
PREFERRED_VERSION_gstreamer1.0-plugins-ugly_krogoth = "1.10.4"

BBMASK_append_krogoth = " meta-wpe-restricted/recipes-connectivity/openssl/openssl10_1.0.%.bbappend"
BBMASK_append_krogoth = " meta-wpe/recipes-graphics/mesa"
BBMASK_append_krogoth = " meta-wpe/recipes-graphics/cairo/cairo_1.16.0.bbappend"
BBMASK_append_krogoth = " meta-wpe/recipes-graphics/drm"
BBMASK_append_krogoth = " meta-wpe/recipes-support/libsoup/libsoup-2.4_2.58.1.bbappend"
BBMASK_append_krogoth = " meta-wpe/recipes-multimedia/gstreamer/gstreamer1.0_1.16.%.bbappend|meta-wpe/recipes-multimedia/gstreamer/gstreamer1.0-plugins-bad_1.16.%.bbappend meta-wpe/recipes-multimedia/gstreamer/gstreamer1.0-plugins-base_1.16%.bbappend meta-wpe/recipes-multimedia/gstreamer/gstreamer1.0-plugins-good_1.16.%.bbappend meta-wpe/recipes-multimedia/gstreamer/gstreamer1.0_1.16.%.bbappend meta-wpe/recipes-multimedia/gstreamer/gstreamer1.0-omx_1.16.%.bbappend"
# FIXME: glibc-locale_2.24 should probably moved to rpi layer
BBMASK_append_krogoth = " meta-wpe/recipes-core/glibc/glibc-locale_2.24.bbappend"
```

## conf/distro/include/thunder_generic_morty.conf
```bitbake
PREFERRED_VERSION_cmake_morty = "3.7.%"
PREFERRED_VERSION_cmake-native_morty = "3.7.%"
PREFERRED_VERSION_gstreamer1.0_morty = "1.10.4"
PREFERRED_VERSION_gstreamer1.0-libav_morty = "1.10.4"
PREFERRED_VERSION_gstreamer1.0-plugins-bad_morty = "1.10.4"
PREFERRED_VERSION_gstreamer1.0-plugins-base_morty = "1.10.4"
PREFERRED_VERSION_gstreamer1.0-plugins-good_morty = "1.10.4"
PREFERRED_VERSION_gstreamer1.0-plugins-ugly_morty = "1.10.4"

BBMASK:append_morty = " meta-wpe-restricted/recipes-connectivity/openssl/openssl10_1.0.%.bbappend"
BBMASK:append_morty = " meta-wpe/recipes-graphics/mesa"
BBMASK:append_morty = " meta-wpe/recipes-graphics/cairo/cairo_1.16.0.bbappend"
BBMASK:append_morty = " meta-wpe/recipes-graphics/drm"
BBMASK:append_morty = " meta-wpe/recipes-support/libsoup/libsoup-2.4_2.58.1.bbappend"
BBMASK:append_morty = " meta-wpe/recipes-multimedia/gstreamer/gstreamer1.0_1.16.%.bbappend|meta-wpe/recipes-multimedia/gstreamer/gstreamer1.0-plugins-bad_1.16.%.bbappend meta-wpe/recipes-multimedia/gstreamer/gstreamer1.0-plugins-base_1.16%.bbappend meta-wpe/recipes-multimedia/gstreamer/gstreamer1.0-plugins-good_1.16.%.bbappend meta-wpe/recipes-multimedia/gstreamer/gstreamer1.0_1.16.%.bbappend meta-wpe/recipes-multimedia/gstreamer/gstreamer1.0-omx_1.16.%.bbappend"
```

## conf/distro/include/thunder_permissions.inc
```bitbake
ROOTFS_POSTPROCESS_COMMAND_append = " update_thunder_path_permissions;"
update_thunder_path_permissions () {
    if [ "${WPEFRAMEWORK_GROUP}" != "" ] && [ "${WPEFRAMEWORK_SUPER_USER_GROUP}" != "" ]; then
        if [ -d "${IMAGE_ROOTFS}/${WPEFRAMEWORK_DATA_PATH}" ]; then
            chmod 0550 "${IMAGE_ROOTFS}/${WPEFRAMEWORK_DATA_PATH}"
            chown "${WPEFRAMEWORK_SUPER_USER_GROUP}:${WPEFRAMEWORK_GROUP}" "${IMAGE_ROOTFS}/${WPEFRAMEWORK_DATA_PATH}"
        fi
	if [ -d "${IMAGE_ROOTFS}/${WPEFRAMEWORK_PERSISTENT_PATH}" ]; then
            chmod 0755 "${IMAGE_ROOTFS}/${WPEFRAMEWORK_PERSISTENT_PATH}"
            chown "${WPEFRAMEWORK_SUPER_USER_GROUP}:${WPEFRAMEWORK_GROUP}" "${IMAGE_ROOTFS}/${WPEFRAMEWORK_PERSISTENT_PATH}"
        fi
	if [ -d "${IMAGE_ROOTFS}/${WPEFRAMEWORK_PERSISTENT_PATH}/WPEFramework" ]; then
            chmod 0770 "${IMAGE_ROOTFS}/${WPEFRAMEWORK_PERSISTENT_PATH}/WPEFramework"
            chown "${WPEFRAMEWORK_SUPER_USER_GROUP}:${WPEFRAMEWORK_SUPER_USER_GROUP}" "${IMAGE_ROOTFS}/${WPEFRAMEWORK_PERSISTENT_PATH}/WPEFramework"
        fi

    fi
}

ROOTFS_POSTPROCESS_COMMAND_append = " update_ocdm_data_path_permissions;"
update_ocdm_data_path_permissions () {
    if [ "${WPEFRAMEWORK_OCDM_GROUP}" != "" ] && [ "${WPEFRAMEWORK_OCDM_SUPER_USER_GROUP}" != "" ]; then
        if [ -d "${IMAGE_ROOTFS}/${WPEFRAMEWORK_DATA_PATH}/OCDM" ]; then
            chmod 0550 "${IMAGE_ROOTFS}/${WPEFRAMEWORK_DATA_PATH}/OCDM"
            chown -R "${WPEFRAMEWORK_OCDM_SUPER_USER_GROUP}:${WPEFRAMEWORK_OCDM_GROUP}" "${IMAGE_ROOTFS}/${WPEFRAMEWORK_DATA_PATH}/OCDM"
        fi
    fi
}

ROOTFS_POSTPROCESS_COMMAND_append = " update_cobalt_data_path_permissions;"
update_cobalt_data_path_permissions () {
    if [ "${WPE_COBALT_USER}" != "" ] && [ "${WPE_COBALT_SUPER_USER_GROUP}" != "" ]; then
        if [ -d "${IMAGE_ROOTFS}/${WPEFRAMEWORK_DATA_PATH}/Cobalt" ]; then
            chmod -R 0550 "${IMAGE_ROOTFS}/${WPEFRAMEWORK_DATA_PATH}/Cobalt"
            chown -R "${WPE_COBALT_USER}:${WPE_COBALT_SUPER_USER_GROUP}" "${IMAGE_ROOTFS}/${WPEFRAMEWORK_DATA_PATH}/Cobalt"
        fi
    fi
}

ROOTFS_POSTPROCESS_COMMAND_append = " update_webkit_data_path_permissions;"
update_webkit_data_path_permissions () {
    if [ "${WPE_WEBKITBROWSER_USER}" != "" ] && [ "${WPE_WEBKITBROWSER_SUPER_USER_GROUP}" != "" ]; then
        if [ -d "${IMAGE_ROOTFS}/${WPEFRAMEWORK_DATA_PATH}/WebKitBrowser" ]; then
            chmod -R 0440 "${IMAGE_ROOTFS}/${WPEFRAMEWORK_DATA_PATH}/WebKitBrowser"
            chown -R "${WPE_WEBKITBROWSER_USER}:${WPE_WEBKITBROWSER_SUPER_USER_GROUP}" "${IMAGE_ROOTFS}/${WPEFRAMEWORK_DATA_PATH}/WebKitBrowser"
        fi
    fi
}
```

## conf/layer.conf
```bitbake
BBPATH .= ":${LAYERDIR}"

BBFILES += "\
    ${LAYERDIR}/recipes-*/*/*.bb \
    ${LAYERDIR}/recipes-*/*/*.bbappend \
"

BBFILE_COLLECTIONS += "wpe-layer"
BBFILE_PATTERN_wpe-layer := "^${LAYERDIR}/"
BBFILE_PRIORITY_wpe-layer = "20"

LAYERSERIES_COMPAT_wpe-layer = "morthy sumo thud warrior zeus dunfell gatesgarth honister"

LAYERDEPENDS_wpe-layer = "\
    core \
    openembedded-layer \
    multimedia-layer \
    networking-layer \
    meta-python \
"

BBFILES_DYNAMIC += "\
    virtualization:${LAYERDIR}/dynamic-layers/virtualization/recipes-*/*/*.bb \
    virtualization:${LAYERDIR}/dynamic-layers/virtualization/recipes-*/*/*.bbappend \
"

LICENSE_PATH += "${LAYERDIR}/licenses"

require distro/include/thunder_generic.conf

# Note: To build wpa_supplicant in the debug mode -R thunder_debug.conf should be used
```
